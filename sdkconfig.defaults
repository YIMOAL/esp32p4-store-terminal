## sdkconfig.defaults
```kconfig
# ESP32-P4 Project Configuration
CONFIG_IDF_TARGET="esp32p4"
CONFIG_ESPTOOLPY_FLASHMODE_QIO=y
CONFIG_ESPTOOLPY_FLASHFREQ_40M=y
CONFIG_ESPTOOLPY_FLASHSIZE_16MB=y
CONFIG_PARTITION_TABLE_CUSTOM=y
CONFIG_COMPILER_OPTIMIZATION_PERF=y
CONFIG_COMPILER_ORPHAN_SECTIONS_PLACE=y

# PSRAM
CONFIG_SPIRAM=y
CONFIG_SPIRAM_SPEED_250M=y
CONFIG_SPIRAM_XIP_FROM_PSRAM=y
CONFIG_SPIRAM_USE_MALLOC=y
CONFIG_SPIRAM_MALLOC_ALWAYSINTERNAL=16384
CONFIG_SPIRAM_MALLOC_RESERVE_INTERNAL=32768
CONFIG_CACHE_L2_CACHE_256KB=y
CONFIG_CACHE_L2_CACHE_LINE_128B=y

# System
CONFIG_ESP_SYSTEM_PANIC_PRINT_HALT=y
CONFIG_FATFS_LFN_HEAP=y

# FreeRTOS
CONFIG_ESP_MAIN_TASK_STACK_SIZE=10240
CONFIG_MQTT_TASK_STACK_SIZE=8192
CONFIG_FREERTOS_HZ=1000
CONFIG_FREERTOS_VTASKLIST_INCLUDE_COREID=y
CONFIG_FREERTOS_GENERATE_RUN_TIME_STATS=y
CONFIG_FREERTOS_TASK_CREATE_ALLOW_EXT_MEM=y

# VFS
CONFIG_VFS_MAX_COUNT=15

# BSP Display
CONFIG_BSP_LCD_DPI_BUFFER_NUMS=3

# LVGL Core
CONFIG_LV_USE_CLIB_MALLOC=y
CONFIG_LV_USE_CLIB_STRING=y
CONFIG_LV_USE_CLIB_SPRINTF=y
CONFIG_LV_DEF_REFR_PERIOD=15
CONFIG_LV_OS_FREERTOS=y
CONFIG_LV_DRAW_SW_DRAW_UNIT_CNT=2
# CONFIG_LV_ATTRIBUTE_FAST_MEM_USE_IRAM is not set

# LVGL Fonts
CONFIG_LV_FONT_MONTSERRAT_12=y
CONFIG_LV_FONT_MONTSERRAT_16=y
CONFIG_LV_FONT_MONTSERRAT_18=y
CONFIG_LV_FONT_MONTSERRAT_22=y
CONFIG_LV_USE_FONT_COMPRESSED=y
CONFIG_LV_TXT_BREAK_CHARS=" ,.;:-_"

# LVGL Monitor
CONFIG_LV_USE_SYSMON=y
CONFIG_LV_USE_PERF_MONITOR=y
CONFIG_LV_USE_IMGFONT=y

# ESP32-P4 旧芯片兼容
CONFIG_ESP32P4_SELECTS_REV_LESS_V3=y
CONFIG_IDF_EXPERIMENTAL_FEATURES=y

CONFIG_SLAVE_IDF_TARGET_ESP32C6=y
CONFIG_ESP_HOSTED_P4_DEV_BOARD_FUNC_BOARD=y
CONFIG_ESP_HOSTED_TRANSPORT_RESTART_ON_FAILURE=n
```
